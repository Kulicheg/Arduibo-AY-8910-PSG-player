#include <SPI.h>

#define SS 12
#define pinRES 15
#define BC1 17
#define BCDIR 16
#define SDcard 6
#define BUTTON_1_PIN 14


byte Register, Value;
int dobavka;
int rBuf;
int curFileNum, curFileNum2;
int Count;
int offset;
long int fileSize, songSize,  SizeBl;
String filePath, folder;
byte jdPos;

SPISettings spiSettings(16000000, MSBFIRST, SPI_MODE0);



void setup()
{
  Serial.begin(115200);
  SPI.begin();





  //init pins

  pinMode(SS, OUTPUT);
  pinMode(BC1, OUTPUT);
  pinMode(BCDIR, OUTPUT);
  pinMode(pinRES, OUTPUT);


  resetAY();



}



void loop()
{

  resetAY();


  byte Buf[]  = {0x00,
           0xff, 0x00, 0x1c, 0x01, 0x01, 0x02, 0xf0, 0x04, 0x8e, 0x07, 0x39, 0x08, 0x10, 0x09, 0x0f, 0x0a,
           0x0f, 0x0b, 0x23, 0x0d, 0x0a, 0xff, 0x02, 0x4f, 0x04, 0x77, 0xff, 0x02, 0xef, 0x04, 0x5e, 0x09,
           0x0e, 0x0a, 0x0e, 0xff, 0x04, 0x8e, 0xff, 0x04, 0x77, 0x0a, 0x0d, 0xff, 0x04, 0x5e, 0x0a, 0x0c,
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           0x04, 0x77, 0x0a, 0x0a, 0xff, 0x00, 0x1c, 0x02, 0xfd, 0x04, 0x8e, 0x09, 0x0f, 0x0a, 0x0f, 0x0b,
           0x23
  };



  int playDo = 256;

  for (int plBuf = 0; plBuf < playDo; plBuf++)
  {

    Register = Buf[plBuf];

    if (Register != 255 and Register != 254)
    {

      Register = Buf[plBuf];
      Value = Buf[plBuf + 1];

      if (plBuf < 255)
      { writeAYRegister(Register, Value);
        Serial.print (Register);
        Serial.print ("=");
        Serial.println (Value);
        plBuf++;

      } else {
        dobavka = Buf[255];
        //plBuf++;

      }

    }
    else
    {
      if (Register == 255)
      {
        delay (20);
        dobavka = -1;
      }

      else
      {
        if (plBuf < 255)
        {
          writeAYRegister(Register, Value);
          Value = Buf[plBuf + 1];
          delay(80 * Value);
          plBuf++;
        } else {
          dobavka = -3;
        }
      }

    

  }
  SizeBl = SizeBl - 1;
}

}





String TwoDigit (String abba)
{
  if (abba.length() == 1)
  {
    abba = "0" + abba;
  }
  return abba;
}


void resetAY()
{
  digitalWrite(pinRES, LOW);
  delay (10);
  digitalWrite(pinRES, HIGH);

  // Initialize the mixer of the AY
  writeAYRegister(0x06, 0x00);
  writeAYRegister(0x07, 0x3e);
  writeAYRegister(0x08, 0x0f);

}


void writeAYRegister(uint8_t address, uint8_t data) {
  SPI.beginTransaction(spiSettings);

  digitalWrite(BC1, LOW);
  digitalWrite(BCDIR, LOW);
  //write address

  digitalWrite(SS, LOW);
  SPI.transfer(address);
  digitalWrite(SS, HIGH);

  digitalWrite(BC1, HIGH);
  digitalWrite(BCDIR, HIGH);

  digitalWrite(BC1, LOW);
  digitalWrite(BCDIR, LOW);

  //write data
  digitalWrite(BC1, LOW);
  digitalWrite(BCDIR, HIGH);

  digitalWrite(SS, LOW);
  SPI.transfer(data);
  digitalWrite(SS, HIGH);

  digitalWrite(BC1, LOW);
  digitalWrite(BCDIR, LOW);

  SPI.endTransaction();
}





